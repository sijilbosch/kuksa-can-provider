VERSION ""

NS_ :

BS_:

BU_: CCU Immobilizer
VAL_TABLE_ InhibitorUnlockState 3 "Others" 2 "Inhibit" 1 "Release" 0 "Default" ;
VAL_TABLE_ KeyPermissionState 3 "Others" 2 "Inhibit" 1 "Release" 0 "Default" ;

BO_ 292 Immo_Key4: 8 Immobilizer
 SG_ Key4_PermissionState : 0|2@1+ (1,0) [0|0] ""  CCU

BO_ 291 Immo_Key3: 8 Immobilizer
 SG_ Key3_PermissionState : 0|2@1+ (1,0) [0|0] ""  CCU

BO_ 290 Immo_Key2: 8 Immobilizer
 SG_ Key2_PermissionState : 0|2@1+ (1,0) [0|0] ""  CCU

BO_ 289 Immo_Key1: 8 Immobilizer
 SG_ Key1_PermissionState : 0|2@1+ (1,0) [0|0] ""  CCU

BO_ 288 Immo_Key0: 8 Immobilizer
 SG_ Key0_PermissionState : 0|2@1+ (1,0) [0|0] ""  CCU

BO_ 308 Immo_InhibitorType4: 8 CCU
 SG_ InhibitorType4_UnlockState : 0|2@1+ (1,0) [0|0] ""  Immobilizer

BO_ 307 Immo_InhibitorType3: 8 CCU
 SG_ InhibitorType3_UnlockState : 0|2@1+ (1,0) [0|0] ""  Immobilizer

BO_ 306 Immo_InhibitorType2: 8 CCU
 SG_ InhibitorType2_UnlockState : 0|2@1+ (1,0) [0|0] ""  Immobilizer

BO_ 305 Immo_InhibitorType1: 8 CCU
 SG_ InhibitorType1_UnlockState : 0|2@1+ (1,0) [0|0] ""  Immobilizer

BO_ 304 Immo_InhibitorType0: 8 CCU
 SG_ InhibitorType0_UnlockState : 0|2@1+ (1,0) [0|0] ""  Immobilizer

BA_DEF_  "BusType" STRING ;
BA_DEF_DEF_  "BusType" "CAN";
VAL_ 292 Key4_PermissionState 3 "Others" 2 "Inhibit" 1 "Release" 0 "Default" ;
VAL_ 291 Key3_PermissionState 3 "Others" 2 "Inhibit" 1 "Release" 0 "Default" ;
VAL_ 290 Key2_PermissionState 3 "Others" 2 "Inhibit" 1 "Release" 0 "Default" ;
VAL_ 289 Key1_PermissionState 3 "Others" 2 "Inhibit" 1 "Release" 0 "Default" ;
VAL_ 288 Key0_PermissionState 3 "Others" 2 "Inhibit" 1 "Release" 0 "Default" ;
VAL_ 308 InhibitorType4_UnlockState 3 "Others" 2 "Inhibit" 1 "Release" 0 "Default" ;
VAL_ 307 InhibitorType3_UnlockState 3 "Others" 2 "Inhibit" 1 "Release" 0 "Default" ;
VAL_ 306 InhibitorType2_UnlockState 3 "Others" 2 "Inhibit" 1 "Release" 0 "Default" ;
VAL_ 305 InhibitorType1_UnlockState 3 "Others" 2 "Inhibit" 1 "Release" 0 "Default" ;
VAL_ 304 InhibitorType0_UnlockState 3 "Others" 2 "Inhibit" 1 "Release" 0 "Default" ;
